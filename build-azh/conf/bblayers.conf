## build-azh/conf/bblayers.conf
```bitbake
# POKY_BBLAYERS_CONF_VERSION is increased each time build/conf/bblayers.conf
# changes incompatibly
POKY_BBLAYERS_CONF_VERSION = "2"

BBPATH = "${TOPDIR}"
BBFILES ?= ""

METAPATH = "/home/anzhenghe/gitlab-azh/yocto/poky"
#METAPATH = "/media/anzhenghe/d256g/yocto/poky"

BBLAYERS ?= " \
  ${METAPATH}/meta \
  ${METAPATH}/meta-poky \
  ${METAPATH}/meta-yocto-bsp \
  ${METAPATH}/meta-openembedded/meta-oe \
  ${METAPATH}/meta-openembedded/meta-python \
  ${METAPATH}/meta-openembedded/meta-perl \
  ${METAPATH}/meta-openembedded/meta-networking \
  ${METAPATH}/meta-raspberrypi \
  ${METAPATH}/meta-arm/meta-arm-toolchain \
  ${METAPATH}/meta-arm/meta-arm \
  ${METAPATH}/meta-ti \
  ${METAPATH}/meta-qt5 \
  ${METAPATH}/meta-anzhenghe/meta-azh \
  "
```

## meta-azh-rpi/conf/layer.conf
```bitbake
# We have a conf and classes directory, append to BBPATH
BBPATH .= ":${LAYERDIR}"

# We have a recipes directory, add to BBFILES
BBFILES += "${LAYERDIR}/images/*.bb ${LAYERDIR}/recipes*/*/*.bb"

BBFILE_COLLECTIONS += "meta-anzhenghe"
BBFILE_PATTERN_meta-anzhenghe := "^${LAYERDIR}/"
BBFILE_PRIORITY_meta-anzhenghe = "16"

LAYERSERIES_COMPAT_meta-anzhenghe = "dunfell"
```

## meta-azh/conf/layer.conf
```bitbake
# We have a conf and classes directory, append to BBPATH
BBPATH .= ":${LAYERDIR}"

# We have a recipes directory, add to BBFILES
BBFILES += "${LAYERDIR}/images/*.bb ${LAYERDIR}/recipes*/*/*.bb"

BBFILE_COLLECTIONS += "meta-azh"
BBFILE_PATTERN_meta-azh := "^${LAYERDIR}/"
BBFILE_PRIORITY_meta-azh = "10"

LAYERSERIES_COMPAT_meta-azh = "dunfell"
```
